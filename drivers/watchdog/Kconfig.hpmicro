## drivers/watchdog/Kconfig.hpmicro
```kconfig
# Copyright (c) 2024-2025
# SPDX-License-Identifier: Apache-2.0

config WDT_HPMICRO_EWDG
	bool "HPMicro Enhanced Watchdog (EWDG) driver"
	default y
	depends on DT_HAS_HPMICRO_HPM_EWDG_ENABLED
	help
	  Enable HPMicro EWDG watchdog driver.

if WDT_HPMICRO_EWDG

config WDT_HPMICRO_EWDG_INTERRUPT
	bool "Enable EWDG timeout interrupt"
	default n
	help
	  Enable interrupt before watchdog reset.

endif # WDT_HPMICRO_EWDG
```

## dts/bindings/watchdog/hpmicro,hpm-ewdg.yaml
```yaml
# Copyright (c) 2024-2025 HPMicro
# SPDX-License-Identifier: Apache-2.0

description: HPMicro Enhanced Watchdog (EWDG)

compatible: "hpmicro,hpm-ewdg"

include: [base.yaml]

properties:
  reg:
    required: true

  interrupts:
    required: false
    description: |
      Optional interrupt for timeout warning before reset.

  clk-source:
    type: string
    default: "osc32k"
    enum:
      - "bus"
      - "osc32k"
    description: |
      Clock source for EWDG counter.

  timeout-ms:
    type: int
    default: 2000
    description: |
      Default watchdog timeout in milliseconds.
      Range depends on clock frequency and divider settings.
```

## soc/hpmicro/HPM5300/Kconfig.soc
```kconfig
config SOC_SERIES_HPM5300
	bool
	select SOC_FAMILY_HPM
	select HAS_HPMSDK_PLLCTLV2
	select HAS_HPMSDK_PCFG
	help
	  Enable support for HPMicro HPM53 series SoC

config SOC_SERIES
	default "HPM5300" if SOC_SERIES_HPM5300

config SOC_HPM5321
	bool
	select SOC_SERIES_HPM5300

config SOC
	default "HPM5321" if SOC_HPM5321
```
